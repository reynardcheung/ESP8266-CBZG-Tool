## ESP8266-CBZG-Tool-Source/module_components/read_info/Kconfig
```kconfig
menu "ESP Read Info"
    menu "MODULE PARAM"
    ####################################################
    config ESP_READ_INFO_MODULE_NAME
        string "Module Name"
        default "NULL"
        help
            Write the name of module.
    ####################################################
    config ESP_READ_INFO_BRIEF
        string "Module Brief"
        default "System Components"
        help
            Write the brief of module.
    ####################################################
    config ESP_READ_INFO_VERSION
        string "Module Version"
        default "3.0.0"
        help
            Write the version of module.
    ####################################################
    config ESP_READ_INFO_CMD_NAME
        string "Command Name"
        default "{ESPREADINFO}"
        help
            Write the name of task.
    ####################################################
        config ESP_READ_INFO_RUNNING
        bool "Task Running"
        default n
        help
            Write the name of task.
    ####################################################
    endmenu
endmenu
```

## ESP8266-CBZG-Tool-Source/module_components/restart/Kconfig
```kconfig
menu "ESP Restart"
    menu "MODULE PARAM"
    ####################################################
    config ESP_RESTART_MODULE_NAME
        string "Module Name"
        default "Restart"
        help
            Write the name of module.
    ####################################################
    config ESP_RESTART_BRIEF
        string "Module Brief"
        default "System Components"
        help
            Write the brief of module.
    ####################################################
    config ESP_RESTART_VERSION
        string "Module Version"
        default "3.0.0"
        help
            Write the version of module.
    ####################################################
    config ESP_RESTART_CMD_NAME
        string "Command Name"
        default "{ESPRESTART}"
        help
            Write the name of task.
    ####################################################
        config ESP_RESTART_RUNNING
        bool "Task Running"
        default n
        help
            Write the name of task.
    ####################################################
    endmenu
endmenu
```

## ESP8266-CBZG-Tool-Source/module_components/set_info/Kconfig
```kconfig
menu "ESP Set Info"
    menu "MODULE PARAM"
    ####################################################
    config ESP_SETTING_MODULE_NAME
        string "Module Name"
        default "Settings"
        help
            Write the name of module.
    ####################################################
    config ESP_SETTING_BRIEF
        string "Module Brief"
        default "System Components"
        help
            Write the brief of module.
    ####################################################
    config ESP_SETTING_VERSION
        string "Module Version"
        default "3.0.0"
        help
            Write the version of module.
    ####################################################
    config ESP_SETTING_CMD_NAME
        string "Command Name"
        default "{ESPSETTING}"
        help
            Write the name of task.
    ####################################################
        config ESP_SETTING_RUNNING
        bool "Task Running"
        default y
        help
            Write the name of task.
    ####################################################
    endmenu
endmenu
```

## ESP8266-CBZG-Tool-Source/module_components/stm32isp_programer/Kconfig
```kconfig
menu "STM32ISP PROGRAMER"
    menu "MODULE PARAM"
    ####################################################
    config STM32ISPPROG_MODULE_NAME
        string "Module Name"
        default "STM32ISPProg"
        help
            Write the name of module.
    ####################################################
    config STM32ISPPROG_BRIEF
        string "Module Brief"
        default "System Components"
        help
            Write the brief of module.
    ####################################################
    config STM32ISPPROG_VERSION
        string "Module Version"
        default "3.0.0"
        help
            Write the version of module.
    ####################################################
    config STM32ISPPROG_CMD_NAME
        string "Command Name"
        default "{STM32ISPPROG}"
        help
            Write the name of task.
    ####################################################
    config STM32ISPPROG_RUNNING
        bool "Task Running"
        default y
        help
            Write the name of task.
    ####################################################
    endmenu
    ####################################################
    config USART_READ_BYTE_WAITTIME
        int "USART Read Time(ms)"
        range 1 10000
        default 20
        help
            Device response timeout.
    ####################################################
    config DEVICE_RESPONSE_TIMEOUT
        int "Device response timeout(ms)"
        range 1 10000
        default 3000
        help
            Device response timeout.
    ####################################################
    config DEVICE_DOWNLOAD_STOP_TIME
        int "Device Download Completed timeout(ms)"
        range 1 10000
        default 300
        help
            Device response timeout.
    ####################################################
    config DEVICE_FLASH_PROG_START_ADDR
        hex "Device Program Address"
        default 0x08000000
        help
            Device Flash Addr.
    ####################################################
    config DEVICE_RESTART_TIME
        int "Device restart time(ms)"
        range 1 10000
        default 100
        help
            Device restart time.
    ####################################################
    choice CHOICE_GPIO0_FUNCTION_MODE
    prompt "GPIO0 Function Configuration"
        default GPIO0_BOOT
        config GPIO0_RST
            bool "Use for RST"
            help
                Set GPIO0 use for RST

        config GPIO0_BOOT
            bool "Use for BOOT"
            help
                Set GPIO0 use for BOOT
    endchoice
    ####################################################
    choice CHOICE_GPIO2_FUNCTION_MODE
    prompt "GPIO2 Function Configuration"
        default GPIO2_RST
        config GPIO2_RST
            bool "Use for RST"
            depends on GPIO0_BOOT
            help
                Set GPIO2 use for RST

        config GPIO2_BOOT
            bool "Use for BOOT"
            depends on GPIO0_RST
            help
                Set GPIO2 use for BOOT
    endchoice

endmenu
```

## ESP8266-CBZG-Tool-Source/module_components/wuart/Kconfig
```kconfig
menu "ESP WUART"
    menu "MODULE PARAM"
####################################################
    config ESP_WUART_MODULE_NAME
        string "Module Name"
        default "WirelessUart"
        help
            Write the name of module.
    ####################################################
    config ESP_WUART_BRIEF
        string "Module Brief"
        default "System Components"
        help
            Write the brief of module.
    ####################################################
    config ESP_WUART_VERSION
        string "Module Version"
        default "3.0.0"
        help
            Write the version of module.
    ####################################################
    config ESP_WUART_CMD_NAME
        string "Command Name"
        default "{ESPWUART}"
        help
            Write the name of task.
    ####################################################
    config ESP_WUART_RUNNING
        bool "Task Running"
        default y
        help
            Write the name of task.
    ####################################################
    endmenu
    config UART_READ_TIMEOUT
        int "Device response timeout(ms)"
        range 1 10000
        default 5
        help
            Device response timeout.
    ####################################################
    config UART_SEND_TIMEOUT
        int "Uart send timeout(ms)"
        range 1 1000
        default 10
        help
            Device response timeout.
    ####################################################
    config UART_READ_CHAR_MAX_LENGTH
        int "UART Read Max Bytes"
        range 1 10240
        default 1024
        help
            Device response timeout.
    ####################################################
endmenu
```

## ESP8266-CBZG-Tool-Source/user_components/Kconfig.projbuild
```kconfig
menu "User System Option"
    source "$ProjectPath/main/Kconfig"
    source "$ProjectPath/user_components/user_wifi_sta_init/Kconfig"
    source "$ProjectPath/user_components/user_gpio_init/Kconfig"
    source "$ProjectPath/user_components/user_heart_beat/Kconfig"
    source "$ProjectPath/user_components/user_uart_init/Kconfig"
    source "$ProjectPath/user_components/user_web_config/Kconfig"
endmenu
```
