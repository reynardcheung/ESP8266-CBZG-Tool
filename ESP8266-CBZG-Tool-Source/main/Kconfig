## ESP8266-CBZG-Tool-Source/user_components/user_gpio_init/Kconfig
```kconfig
menu "GPIO Configuration"
    menu "GPIO0"
        ####################################################
        choice CHOICE_GPIO0_MODE
            prompt "GPIO MODE"
            default GPIO0_MODE_OUTPUT

            config GPIO0_MODE_DISABLE
                prompt "GPIO_MODE_DISABLE"
                bool "Disable"
                help
                    Disable assertions, adding -DNDEBUG to CPPFLAGS.

            config GPIO0_MODE_INPUT
                prompt "GPIO_MODE_INPUT"
                bool "Input"
                help
                    Set GPIO0 as input mode.

            config GPIO0_MODE_OUTPUT
                prompt "GPIO_MODE_OUTPUT"
                bool "Output"
                help
                    Set GPIO0 as output mode.

            config GPIO0_MODE_OUTPUT_OD
                prompt "GPIO_MODE_OUTPUT_OD"
                bool "Output Open-Drain"
                help
                    Set GPIO0 as output open-drain mode.
        endchoice
        config GPIO0_MODE
            int
            depends on GPIO0_MODE_DISABLE
            default GPIO_MODE_DISABLE

        config GPIO0_MODE
            int
            depends on GPIO0_MODE_INPUT
            default GPIO_MODE_INPUT

        config GPIO0_MODE
            int
            depends on GPIO0_MODE_OUTPUT
            default GPIO_MODE_OUTPUT

        config GPIO0_MODE
            int
            depends on GPIO0_MODE_OUTPUT_OD
            default GPIO_MODE_OUTPUT_OD
        ####################################################
        choice CHOICE_GPIO0_Pull_Down_MODE
            prompt "GPIO PullDown Configuration"
            default GPIO0_PullDown_Enalbe
            config GPIO0_PullDown_Enalbe
                prompt "GPIO_PULLDOWN_ENABLE"
                bool "ENABLE"
                help
                    Enable GPIO0 Pull Down

            config GPIO0_PullDown_Disable
                prompt "GPIO_PULLDOWN_DISABLE"
                bool "DISABLE"
                help
                    DIsable GPIO0 Pull Down
        endchoice
        config GPIO0_PULLDOWN_MODE
            int
            depends on GPIO0_PullDown_Enalbe
            default GPIO_PULLDOWN_ENABLE

        config GPIO0_PULLDOWN_MODE
            int
            depends on GPIO0_PullDown_Disable
            default GPIO_PULLDOWN_DISABLE
        ####################################################
        choice CHOICE_GPIO0_Pull_Up_MODE
            prompt "GPIO PullUp Configuration"
            default GPIO0_PullUp_Enalbe
            config GPIO0_PullUp_Enalbe
                prompt "GPIO_PULLUP_ENABLE"
                bool "ENABLE"
                help
                    Enable GPIO0 Pull Down

            config GPIO0_PullUp_Disable
                prompt "GPIO_PULLUP_DISABLE"
                bool "DISABLE"
                help
                    DIsable GPIO0 Pull Down
        endchoice
        config GPIO0_PULLUP_MODE
            int
            depends on GPIO0_PullUp_Enalbe
            default GPIO_PULLUP_ENABLE

        config GPIO0_PULLUP_MODE
            int
            depends on GPIO0_PullUp_Disable
            default GPIO_PULLUP_DISABLE
        ####################################################
        config GPIO0_INTR_LEVEL
            int "Interrupt level"
            range 0 6
            default 0
            help
                GPIO_INTR_DISABLE = 0,      Disable GPIO interrupt
                GPIO_INTR_POSEDGE = 1,      GPIO interrupt type : rising edge
                GPIO_INTR_NEGEDGE = 2,      GPIO interrupt type : falling edge
                GPIO_INTR_ANYEDGE = 3,      GPIO interrupt type : both rising and falling edge
                GPIO_INTR_LOW_LEVEL = 4,    GPIO interrupt type : input low level trigger
                GPIO_INTR_HIGH_LEVEL = 5,   GPIO interrupt type : input high level trigger
                GPIO_INTR_MAX = 6
        ####################################################
        config GPIO0_INIT_LEVEL
            int "GPIO0 Init Level"
            range 0 1
            default 0
            help
                HIGH:1,
                LOW:0
    endmenu

    menu "GPIO2"
        ####################################################
        choice CHOICE_GPIO2_MODE
            prompt "GPIO MODE"
            default GPIO2_MODE_OUTPUT

            config GPIO2_MODE_DISABLE
                prompt "GPIO_MODE_DISABLE"
                bool "Disable"
                help
                    Disable assertions, adding -DNDEBUG to CPPFLAGS.

            config GPIO2_MODE_INPUT
                prompt "GPIO_MODE_INPUT"
                bool "Input"
                help
                    Set GPIO2 as input mode.

            config GPIO2_MODE_OUTPUT
                prompt "GPIO_MODE_OUTPUT"
                bool "Output"
                help
                    Set GPIO2 as output mode.

            config GPIO2_MODE_OUTPUT_OD
                prompt "GPIO_MODE_OUTPUT_OD"
                bool "Output Open-Drain"
                help
                    Set GPIO2 as output open-drain mode.
        endchoice
        config GPIO2_MODE
            int
            depends on GPIO2_MODE_DISABLE
            default GPIO_MODE_DISABLE

        config GPIO2_MODE
            int
            depends on GPIO2_MODE_INPUT
            default GPIO_MODE_INPUT

        config GPIO2_MODE
            int
            depends on GPIO2_MODE_OUTPUT
            default GPIO_MODE_OUTPUT

        config GPIO2_MODE
            int
            depends on GPIO2_MODE_OUTPUT_OD
            default GPIO_MODE_OUTPUT_OD
        ####################################################
        choice CHOICE_GPIO2_Pull_Down_MODE
            prompt "GPIO PullDown Configuration"
            default GPIO2_PullDown_Enalbe
            config GPIO2_PullDown_Enalbe
                prompt "GPIO_PULLDOWN_ENABLE"
                bool "ENABLE"
                help
                    Enable GPIO2 Pull Down

            config GPIO2_PullDown_Disable
                prompt "GPIO_PULLDOWN_DISABLE"
                bool "DISABLE"
                help
                    DIsable GPIO2 Pull Down
        endchoice
        config GPIO2_PULLDOWN_MODE
            int
            depends on GPIO2_PullDown_Enalbe
            default GPIO_PULLDOWN_ENABLE

        config GPIO2_PULLDOWN_MODE
            int
            depends on GPIO2_PullDown_Disable
            default GPIO_PULLDOWN_DISABLE
        ####################################################
        choice CHOICE_GPIO2_Pull_Up_MODE
            prompt "GPIO PullUp Configuration"
            default GPIO2_PullUp_Enalbe
            config GPIO2_PullUp_Enalbe
                prompt "GPIO_PULLUP_ENABLE"
                bool "ENABLE"
                help
                    Enable GPIO2 Pull Down

            config GPIO2_PullUp_Disable
                prompt "GPIO_PULLUP_DISABLE"
                bool "DISABLE"
                help
                    DIsable GPIO2 Pull Down
        endchoice
        config GPIO2_PULLUP_MODE
            int
            depends on GPIO2_PullUp_Enalbe
            default GPIO_PULLUP_ENABLE

        config GPIO2_PULLUP_MODE
            int
            depends on GPIO2_PullUp_Disable
            default GPIO_PULLUP_DISABLE
        ####################################################
        config GPIO2_INTR_LEVEL
            int "Interrupt level"
            range 0 6
            default 0
            help
                GPIO_INTR_DISABLE = 0,      Disable GPIO interrupt
                GPIO_INTR_POSEDGE = 1,      GPIO interrupt type : rising edge
                GPIO_INTR_NEGEDGE = 2,      GPIO interrupt type : falling edge
                GPIO_INTR_ANYEDGE = 3,      GPIO interrupt type : both rising and falling edge
                GPIO_INTR_LOW_LEVEL = 4,    GPIO interrupt type : input low level trigger
                GPIO_INTR_HIGH_LEVEL = 5,   GPIO interrupt type : input high level trigger
                GPIO_INTR_MAX = 6
        ####################################################
        config GPIO2_INIT_LEVEL
            int "GPIO2 Init Level"
            range 0 1
            default 1
            help
                HIGH:1,
                LOW:0
    endmenu
endmenu
```

## ESP8266-CBZG-Tool-Source/user_components/user_heart_beat/Kconfig
```kconfig
menu "Heart Beat Configuration"
    choice CHOICE_HEART_BEAT_MODE
        prompt "Heart Beat SWITCH Configuration"
        default HEART_BEAT_ENABLE
        config HEART_BEAT_ENABLE
            prompt "HEART_BEAT_ENABLE"
            bool "Heart Beat Enable"
            help
                Heart Beat Enable.

        config HEART_BEAT_DISABLE
            prompt "HEART_BEAT_DISABLE"
            bool "Heart Beat Disable"
            help
                Heart Beat Disable.
    endchoice
    config HEART_BEAT_TIME
        int "Heart Beat TimeOut(s)"
        range 1 300
        default 36
        help
            Heart Beat Time.
endmenu
```

## ESP8266-CBZG-Tool-Source/user_components/user_uart_init/Kconfig
```kconfig
menu "UART Configuration"
    menu "UARTO"
        config UART0_BAUD_RATE
        int "Baud Rate"
        range 1200 9216000
        default 115200
        help
            Baud Rate.

        config UART0_DATA_BITS
        int "Data Bits(0->5,1->6,2->7,3->8)"
        range 1 3
        default 3
        help
            DATA BITS(0->5,1->6,2->7,3->8).

        config UART0_STOP_BITS
        int "Stop Bits(1->1,2->1.5,3->2)"
        range 0 3
        default 1
        help
            STOP BITS(1->1,2->1.5,3->2).

        config UART0_PARITY
        int "PARITY(0->OFF,2->EVEN,3->ODD)"
        range 0 3
        default 0
        help
            PARITY(0->OFF,2->EVEN,3->ODD).

        config UART0_MAX_RECEIVE_DATA_LEN
            int "Max Length Of Receive Char"
            range 257 1024
            default 257
            help
                Write the length for max receive char.

        config UART0_MAX_RECEIVE_QUEUE_LEN
            int "Max Number Of Receive Queue"
            range 1 256
            default 8
            help
                Write the length for max receive queue.

        endmenu
        menu "UART1"
        endmenu
endmenu
```

## ESP8266-CBZG-Tool-Source/user_components/user_wifi_sta_init/Kconfig
```kconfig
menu "WIFI Connect Configuration"
    config WIFI_SSID
        string "WiFi SSID"
        default "Bilibili"
        help
            SSID (network name) for the program to connect to.

    config WIFI_PASSWORD
        string "WiFi Password"
        default "bili_75131931192"
        help
            WiFi password (WPA or WPA2) for the program to use.
            Can be left blank if the network has no security set.
    config WIFI_CHANNEL
        int "Wifi Channel"
        range 1 14
        default 10
        help
            The Channel to which the client will connect to.
    config WIFI_MAX_CONNECT_RETRY
        int "Wifi Connect Max Retry"
        range 0 65535
        default 8
        help
            Connect to the wifi.
endmenu

menu "Client Connect Configuration"

    choice IP_MODE
        prompt "IP Version"
        help
        Device can use either IPV4 or IPV6.

    config IPV4
        select IPV4
        bool "IPV4"

    config IPV6
    bool "IPV6"

    endchoice

    config IPV4_ADDR
        string "IPV4 Address"
        default "192.168.137.1"
        depends on IPV4
        help
        The device will connect to this IPV4 address.

    config IPV6_ADDR
        string "IPV6 Address"
        default "FE80::30AD:E57B:C212:68AD"
        depends on IPV6
        help
        The device will connect to this IPV6 address.

    config PORT
        int "TCP Port"
        range 0 65535
        default 25565
        help
            The remote port to which the client will connect to.

    config UDP_PORT
        int "UDP Port"
        range 0 65535
        default 25566
        help
            The remote port to which the client will connect to.
endmenu
```
