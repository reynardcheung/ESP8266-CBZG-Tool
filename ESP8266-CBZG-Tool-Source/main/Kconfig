## ESP8266-CBZG-Tool-Source/main/Kconfig
```kconfig
menu "FreeRTOS Task Configuration"
    menu "wifi_client_task"
        ####################################################
        config WIFI_CLIENT_TASK_NAME
            string "Task Name"
            default "wifi_client"
            help
                Write the name of task.
        ####################################################
        config WIFI_CLIENT_STACK_DEPTH
            int "Stack Depth"
            range 0 65535
            default 2048
            help
                Write the Stack of task.
        ####################################################
        config WIFI_CLIENT_PRIORITY
            int "Priority"
            range 1 9
            default 5
            help
                Write the Priority of task.
        ####################################################
    endmenu
    menu "wifi_client_udp_task"
        ####################################################
        config WIFI_CLIENT_UDP_TASK_NAME
            string "Task Name"
            default "wifi_client_udp"
            help
                Write the name of task.
        ####################################################
        config WIFI_CLIENT_UDP_STACK_DEPTH
            int "Stack Depth"
            range 0 65535
            default 2048
            help
                Write the Stack of task.
        ####################################################
        config WIFI_CLIENT_UDP_PRIORITY
            int "Priority"
            range 1 9
            default 5
            help
                Write the Priority of task.
        ####################################################
    endmenu
    menu "wifi_reconnect_task"
        ####################################################
        config WIFI_RECONNECT_TASK_NAME
            string "Task Name"
            default "wifi_reconnect"
            help
                Write the name of task.
        ####################################################
        config WIFI_RECONNECT_STACK_DEPTH
            int "Stack Depth"
            range 0 65535
            default 2048
            help
                Write the Stack of task.
        ####################################################
        config WIFI_RECONNECT_PRIORITY
            int "Priority"
            range 1 9
            default 6
            help
                Write the Priority of task.
        ####################################################
    endmenu
endmenu
```

## ESP8266-CBZG-Tool-Source/module_components/I2C_Tool/Kconfig
```kconfig
menu "I2C Tool"
    menu "MODULE PARAM"
    ####################################################
    config I2C_TOOL_MODULE_NAME
        string "Module Name"
        default "I2CTool"
        help
            Write the name of module.
    ####################################################
    config I2C_TOOL_BRIEF
        string "Module Brief"
        default "System Components"
        help
            Write the brief of module.
    ####################################################
    config I2C_TOOL_VERSION
        string "Module Version"
        default "3.0.0"
        help
            Write the version of module.
    ####################################################
    config I2C_TOOL_CMD_NAME
        string "Command Name"
        default "{I2CTOOL}"
        help
            Write the name of task.
    ####################################################
        config I2C_TOOL_RUNNING
        bool "Task Running"
        default y
        help
            Write the name of task.
    ####################################################
    endmenu
endmenu
```

## ESP8266-CBZG-Tool-Source/module_components/Kconfig.projbuild
```kconfig
menu "User Module Option"
    source "$ProjectPath/module_components/command_components/Kconfig"
    source "$ProjectPath/module_components/get_id/Kconfig"
    source "$ProjectPath/module_components/get_version/Kconfig"
    source "$ProjectPath/module_components/get_module/Kconfig"
    source "$ProjectPath/module_components/heart_beat/Kconfig"
    source "$ProjectPath/module_components/read_info/Kconfig"
    source "$ProjectPath/module_components/restart/Kconfig"
    source "$ProjectPath/module_components/set_info/Kconfig"
    source "$ProjectPath/module_components/wuart/Kconfig"
    source "$ProjectPath/module_components/gpio_manager/Kconfig"
    source "$ProjectPath/module_components/I2C_Tool/Kconfig"
    source "$ProjectPath/module_components/SSD1306/Kconfig"
    source "$ProjectPath/module_components/stm32isp_programer/Kconfig"
endmenu
```

## ESP8266-CBZG-Tool-Source/module_components/SSD1306/Kconfig
```kconfig
menu "SSD1306"
    menu "MODULE PARAM"
    ####################################################
    config SSD1306_MODULE_NAME
        string "Module Name"
        default "SSD1306"
        help
            Write the name of module.
    ####################################################
    config SSD1306_BRIEF
        string "Module Brief"
        default "System Components"
        help
            Write the brief of module.
    ####################################################
    config SSD1306_VERSION
        string "Module Version"
        default "3.0.0"
        help
            Write the name of module.
    ####################################################
    config SSD1306_CMD_NAME
        string "Command Name"
        default "{SSD1306}"
        help
            Write the name of task.
    ####################################################
        config SSD1306_RUNNING
        bool "Task Running"
        default y
        help
            Write the name of task.
    ####################################################
    endmenu
endmenu
```

## ESP8266-CBZG-Tool-Source/module_components/command_components/Kconfig
```kconfig
menu "Command Analyse"
    ####################################################
    config CommandAnalyse_NAME
        string "Task Name"
        default "C_A_Task"
        help
            Write the name of task.
    ####################################################
    config CommandAnalyse_STACK_DEPTH
        int "Stack Depth"
        range 0 65535
        default 2048
        help
            Write the Stack of task.
    ####################################################
    config CommandAnalyse_PRIORITY
        int "Priority"
        range 1 9
        default 5
        help
            Write the Priority of task.
    ####################################################
    config MAX_RECEIVE_DATA_LEN
        int "max length of receive char"
        range 128 4096
        default 1024
        help
            Write the length for max receive char.
    ####################################################
    config CommandAnalyseQueueLength
        int "CommandAnalyseQueue Length"
        range 1 128
        default 4
        help
            This option can set the queue length.
    ####################################################
    config MAX_COMMAND_NUM
        int "Max Command Num"
        range 1 128
        default 32
        help
            This option can set the Command length.
    ####################################################
    config MAX_COMMAND_NAME_LENGTH
    int "Max char of command name"
    range 1 1024
    default 64
    help
        The Char Of Command Name.
    ####################################################
endmenu 
menu "Running Action"
    ####################################################
    config RunningActionTask_NAME
        string "Task Name"
        default "R_A_Task"
        help
            Write the name of task.
    ####################################################
    config RunningActionTask_STACK_DEPTH
        int "Stack Depth"
        range 0 65535
        default 2048
        help
            Write the Stack of task.
    ####################################################
    config RunningActionTask_PRIORITY
        int "Priority"
        range 1 9
        default 5
        help
            Write the Priority of task.
    ####################################################
    config ACTION_INTERVAL
    int "Running Action Interval"
    range 1 1000
    default 100
    help
        Scan data queue interval.
    ####################################################
    config DataQueueLength
        int "Data Length"
        range 1 128
        default 4
        help
            This option can set the queue length.
endmenu
```

## ESP8266-CBZG-Tool-Source/module_components/example_module/Kconfig
```kconfig
menu "EXAMPLE MODULE"
    menu "MODULE PARAM"
    ####################################################
    config ESP_GET_ID_MODULE_NAME
        string "Module Name"
        default "NULL"
        help
            Write the name of module.
    ####################################################
    config EXAMPLE_BRIEF
        string "Module Brief"
        default "EXAMPLE"
        help
            Write the brief of module.
    ####################################################
    config EXAMPLE_VERSION
        string "Module Version"
        default "3.0.0"
        help
            Write the versiion of module.
    ####################################################
    config EXAMPLE_CMD_NAME
        string "Command Name"
        default "{EXAMPLE}"
        help
            Write the name of task.
    ####################################################
    config EXAMPLE_RUNNING
        bool "Task Running"
        default y
        help
            Write the name of task.
    ####################################################
    endmenu
endmenu
```

## ESP8266-CBZG-Tool-Source/module_components/get_id/Kconfig
```kconfig
menu "ESP GET ID"
    menu "MODULE PARAM"
    ####################################################
    config ESP_GET_ID_MODULE_NAME
        string "Module Name"
        default "NULL"
        help
            Write the name of module.
    ####################################################
    config ESP_GET_ID_BRIEF
        string "Module Brief"
        default "System Components"
        help
            Write the brief of module.
    ####################################################
    config ESP_GET_ID_VERSION
        string "Module Version"
        default "3.0.0"
        help
            Write the versiion of module.
    ####################################################
    config ESP_GET_ID_CMD_NAME
        string "Command Name"
        default "{ESPGETID}"
        help
            Write the name of task.
    ####################################################
    config ESP_GET_ID_RUNNING
        bool "Task Running"
        default n
        help
            Write the name of task.
    ####################################################
    endmenu
endmenu
```

## ESP8266-CBZG-Tool-Source/module_components/get_module/Kconfig
```kconfig
menu "ESP MODULE"
    menu "MODULE PARAM"
    ####################################################
    config ESP_GET_MODULE_MODULE_NAME
        string "Module Name"
        default "NULL"
        help
            Write the name of module.
    ####################################################
    config ESP_GET_MODULE_BRIEF
        string "Command Name"
        default "System Components"
        help
            Write the brief of module.
    ####################################################
    config ESP_GET_MODULE_VERSION
        string "Command Name"
        default "3.0.0"
        help
            Write the version of module.
    ####################################################
    config ESP_GET_MODULE_CMD_NAME
        string "Command Name"
        default "{ESPGETMODULE}"
        help
            Write the name of task.
    ####################################################
        config ESP_GET_MODULE_RUNNING
        bool "Task Running"
        default n
        help
            Write the name of task.
    ####################################################
    endmenu
endmenu
```

## ESP8266-CBZG-Tool-Source/module_components/get_version/Kconfig
```kconfig
menu "ESP Version"
    menu "MODULE PARAM"
    ####################################################
    config ESP_GET_VERSION_MODULE_NAME
        string "Module Name"
        default "NULL"
        help
            Write the name of module.
    ####################################################
    config ESP_GET_VERSION_BRIEF
        string "Module Brief"
        default "System Components"
        help
            Write the brief of module.
    ####################################################
    config ESP_GET_VERSION_VERSION
        string "Module Version"
        default "3.0.0"
        help
            Write the version of module.
    ####################################################
    config ESP_GET_VERSION_CMD_NAME
        string "Command Name"
        default "{ESPGETVERSION}"
        help
            Write the name of task.
    ####################################################
        config ESP_GET_VERSION_RUNNING
        bool "Task Running"
        default n
        help
            Write the name of task.
    ####################################################
    endmenu
    config ESP_DEVICE_VERSION
        string "ESP Device Version"
        default "3.5.0"
        help
            If you dont know what you do.Do not edit.
    ####################################################
endmenu
```

## ESP8266-CBZG-Tool-Source/module_components/gpio_manager/Kconfig
```kconfig
menu "GPIO Manager"
    menu "MODULE PARAM"
    ####################################################
    config GPIO_MANAGER_MODULE_NAME
        string "Module Name"
        default "GPIOManager"
        help
            Write the name of module.
    ####################################################
    config GPIO_MANAGER_BRIEF
        string "Module Brief"
        default "System Components"
        help
            Write the brief of module.
    ####################################################
    config GPIO_MANAGER_VERSION
        string "Module Version"
        default "3.0.0"
        help
            Write the version of module.
    ####################################################
    config GPIO_MANAGER_CMD_NAME
        string "Command Name"
        default "{GPIOManager}"
        help
            Write the name of task.
    ####################################################
        config GPIO_MANAGER_RUNNING
        bool "Task Running"
        default y
        help
            Write the name of task.
    ####################################################
    endmenu
endmenu
```

## ESP8266-CBZG-Tool-Source/module_components/heart_beat/Kconfig
```kconfig
menu "ESP Heart Beat"
    menu "MODULE PARAM"
    ####################################################
    config ESP_HEART_BEAT_MODULE_NAME
        string "Module Name"
        default "NULL"
        help
            Write the name of module.
    ####################################################
    config ESP_HEART_BEAT_BRIEF
        string "Module Brief"
        default "System Components"
        help
            Write the brief of module.
    ####################################################
    config ESP_HEART_BEAT_VERSION
        string "Module Version"
        default "3.0.0"
        help
            Write the version of module.
    ####################################################
    config ESP_HEART_BEAT_CMD_NAME
        string "Command Name"
        default "{ESPHEARTBEAT}"
        help
            Write the name of task.
    ####################################################
        config ESP_HEART_BEAT_RUNNING
        bool "Task Running"
        default n
        help
            Write the name of task.
    ####################################################
    endmenu
endmenu
```
